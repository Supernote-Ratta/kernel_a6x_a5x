## drivers/gpu/drm/rockchip/eink/Kconfig
```kconfig
menuconfig EBC
	bool "eBook Controller"
#	depends on FB_ROCKCHIP
	help
	eBook controller could help to driver the electronic ink screen.

choice
	prompt "Controller type select"
	depends on EBC
	help
	Two type support, hardware means that controller is embedded
	in cpu inside(exp RK3026), software means that using lcdc
	controller to simulate the eink timing(exp RK3188 & RK3288).
config SOFTWARE_EBC
	bool "Software eBook controller"
endchoice

choice
	prompt "Eink temperature sensor"
	depends on EBC
	default EPD_TPS65185_SENSOR
config EPD_LM75
	bool "LM75"
config EPD_NTC
	bool "NTC"
config EPD_G871
	bool "G871"
config EPD_TPS65185_SENSOR
	bool "Tps65185"
endchoice

choice
	prompt "Waveform stored position"
	depends on EBC
	default WAVEFORM_FROM_NAND_FLASH
config WAVEFORM_FROM_GPIO_SPI
	bool "gpio analog spi flash"
config WAVEFORM_FROM_RK_SPI
	bool "RK spi flash"
config WAVEFORM_FROM_NAND_FLASH
	bool "nand flash"
config WAVEFORM_FROM_WAVEFORM_FILE
	bool "ramdisk file"
endchoice

choice
	prompt "Waveform format"
	depends on EBC
config RKF_WAVEFORM
	bool "RKF Waveform Format"
config PVI_WAVEFORM
	bool "PVI Waveform Format"
config OED_WAVEFORM
	bool "OED Waveform Format"
endchoice

choice
	prompt "GRAY16 refresh mode"
	depends on EBC
	default GRAY16_TO_GL16
config GRAY16_TO_GC16
	bool "Map to GC16"
config GRAY16_TO_GL16
	bool "Map to GL16"
config GRAY16_TO_GLR16
	bool "Map to GLR16"
config GRAY16_TO_GLD16
	bool "Map to GLD16"
endchoice

choice
	prompt "AUTO refresh mode"
	depends on EBC
	default AUTO_TO_GC16
config AUTO_TO_GC16
	bool "Map to GC16"
config AUTO_TO_GL16
	bool "Map to GL16"
config AUTO_TO_GLR16
	bool "Map to GLR16"
config AUTO_TO_GLD16
	bool "Map to GLD16"
endchoice

config EBC_BOOT_ANI
	bool "bootup animation"
	depends on EBC
	help
	This could help to support a kernel bootup animation

if EBC_BOOT_ANI
	source "drivers/gpu/drm/rockchip/eink/bootani/Kconfig"
endif
```

## drivers/gpu/drm/rockchip/eink/bootani/Kconfig
```kconfig
#
# ebc bootup animation configuration
#
menu "ebc boot animation config"
	depends on EBC
config EBC_BOOT_ANI_LOOP
	bool "bootup animation loop"
	depends on EBC_BOOT_ANI
	---help---
	select this config,support bootup animation loop,else none.

config EBC_ANI_CYC_TIME
	int "bootup animation cycle time"
	depends on EBC_BOOT_ANI
	default "1000"
---help---
	time = value*1 ms

	
choice
	prompt "bootup animation brush mode"
	depends on EBC_BOOT_ANI
	default EBC_BOOT_ANI_PART
config EBC_BOOT_ANI_A2
	bool "EBC_BOOT_ANI_A2"
config EBC_BOOT_ANI_PART
	bool "EBC_BOOT_ANI_PART"	
config EBC_BOOT_ANI_FULL
	bool "EBC_BOOT_ANI_FULL"	
endchoice
	
endmenu
```

## drivers/gpu/drm/rockchip/ht_eink/Kconfig
```kconfig
config HTFY_EBC
	tristate "Htfyun SoftEbc support"
	depends on DRM_ROCKCHIP
	select EPD_TPS65185_SENSOR
	help
	The RK-SOFT-EBC for Htfyun.

config HTFY_DUMP
	tristate "Htfyun dump kernel-buffer support"
	depends on HTFY_EBC
	default no
	help
	dump kernel buffer by /dev/htdump_ctrl and /dev/htdump_data .
	
config HTFY_DEBUG
	tristate "Htfyun debug prink-log support"
	depends on HTFY_EBC
	default yes
	help
	config the run-time debug-prink on demand.	
	
```

## drivers/input/fingerprint/Kconfig
```kconfig
menuconfig INPUT_FINGERPRINT
	bool "Fingerprint"
	help
	  Say Y here, and a list of supported Fingerprint will be displayed.

	  If unsure, say Y.

if INPUT_FINGERPRINT

source "drivers/input/fingerprint/ft9366/Kconfig"
source "drivers/input/fingerprint/gf3626/Kconfig"
endif
```

## drivers/input/fingerprint/ft9366/Kconfig
```kconfig
config FOCALTECH_FINGERPRINT
	tristate "FocalTech FingerPrint"
	default y
   	help
		If you say Y to this option, support will be included for
		the FocalTech's fingerprint sensor. This driver supports
		both REE and TEE.

		This driver can also be built as a module. If so, the module
		will be called 'focaltech_fp'.
```

## drivers/input/touchscreen/focaltech_touch_5726/Kconfig
```kconfig
#
# Focaltech Touchscreen driver configuration
#

config TOUCHSCREEN_FT5726
    bool "Focaltech Touchscreen 5726"
    default n
    help
      Say Y here if you have Focaltech touch panel.
      If unsure, say N.
      
config TOUCHSCREEN_FT5726_DIRECTORY
    string "Focaltech ts directory name"
    default "focaltech_touch_5726"
    depends on TOUCHSCREEN_FT5726
    
```

## drivers/input/touchscreen/focaltech_touch_5xxx/Kconfig
```kconfig
#
# Focaltech Touchscreen driver configuration
#

config TOUCHSCREEN_FTS_5XXX
    bool "Focaltech Touchscreen 5xxx"
    default n
    help
      Say Y here if you have Focaltech touch panel.
      If unsure, say N.

config TOUCHSCREEN_FTS_5XXX_DIRECTORY
    string "Focaltech ts directory name"
    default "focaltech_touch"
    depends on TOUCHSCREEN_FTS_5XXX
```

## drivers/input/touchscreen/ft5x26/Kconfig
```kconfig
#
#  Touchscreen ft5x driver configuration
#

config TOUCHSCREEN_FT5X26_TS
       tristate  "ft5x26 touchscreen driver"
       default y
       depends on INPUT && I2C
       help
         ft5x touchscreen driver
```

## drivers/misc/htfyun/Kconfig
```kconfig
#
# htfyun misc driver configuration
#
menuconfig HTFYUN_MISC_SUPPORT
    bool "htfyun misc support"
    help
      Say Y here, and a list of supported htfyun misc will be displayed.
      This option doesn't affect the kernel.

if HTFYUN_MISC_SUPPORT

config HALL_GPIO
    bool "Hall sensor observe for its action is like headset"
    default n

config HTFYUN_HEADSET
	bool "HTFYUN adc-gpio headset detect"
	default y
	help
		This supports the use of the ADC interface on RK processors.

endif
```

## drivers/net/lte/Kconfig
```kconfig
#
# LTE network device configuration
#

menuconfig LTE
	bool "Rockchip LTE support"
	help
	Enable LTE drivers for Rockchip platform.

if LTE
config LTE_RM310
	bool "LTE rm310 support"
	default n

config LTE_YIYUAN
	bool "LTE yiyuan support"
	default n
endif
```
